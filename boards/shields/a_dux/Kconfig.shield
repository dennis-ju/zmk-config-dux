## boards/shields/a_dux/Kconfig.shield
```kconfig
# No whitespace after the comma or in the keyboard name!
config SHIELD_A_DUX_DONGLE
    def_bool $(shields_list_contains,a_dux_dongle)

config SHIELD_A_DUX_LEFT
    def_bool $(shields_list_contains,a_dux_left)

config SHIELD_A_DUX_RIGHT
    def_bool $(shields_list_contains,a_dux_right)
```
